## components/chmorgan__esp-audio-player/Kconfig
```kconfig
menu "Audio playback"

    config AUDIO_PLAYER_ENABLE_MP3
        bool "Enable mp3 decoding."
        default y
        help
            The audio player can play mp3 files using libhelix-mp3.
    config AUDIO_PLAYER_ENABLE_WAV
        bool "Enable wav file playback"
        default y
        help
            Audio player can decode wave files.

    config AUDIO_PLAYER_ENABLE_AAC
        bool "Enable AAC/HE-AAC decoding (requires espressif/esp_audio_codec)"
        default y
        help
            Decode AAC-LC, HE-AAC, and HE-AACv2 streams using Espressif's
            esp_audio_codec component. Adds ~100 KB to flash. Most internet
            radio stations stream in either MP3 or AAC, so enabling both is
            recommended.

    config AUDIO_PLAYER_LOG_LEVEL
        int "Audio Player log level (0 none - 3 highest)"
        default 0
        range 0 3
        help
            Specify the verbosity of Audio Player log output.
endmenu
```

## main/Kconfig.projbuild
```kconfig
menu "Spotpear MP3 Radio"

    config RADIO_WIFI_SSID
        string "WiFi SSID"
        default ""

    config RADIO_WIFI_PASSWORD
        string "WiFi password"
        default ""

    config RADIO_DEFAULT_STREAM_NAME
        string "Default radio station name"
        default "Internet Radio"

    config RADIO_DEFAULT_STREAM_URL
        string "Default radio stream URL"
        default ""

    config OPENAI_API_KEY
        string "OpenAI API key"
        default ""
        help
            Leave empty and put the key on the SD card instead
            (/openai.txt with "key=sk-..."), so it is never committed.
            A value set here is baked into the firmware binary.

    config OPENAI_CHAT_MODEL
        string "OpenAI chat model"
        default "gpt-4.1-mini"

    config OPENAI_TRANSCRIBE_MODEL
        string "OpenAI speech to text model"
        default "gpt-4o-mini-transcribe"

    config OPENAI_TTS_MODEL
        string "OpenAI text to speech model"
        default "gpt-4o-mini-tts"

    config AI_RECORD_SECONDS
        int "AI record seconds"
        default 5
        range 2 15

    config BATTERY_ADC_CHANNEL
        int "Battery ADC1 channel (GPIO1=0, GPIO2=1, GPIO3=2 ...)"
        default 0
        range 0 9
        help
            ADC1 channel connected to the battery voltage divider.
            Channel 0 = GPIO1 (default for Spotpear 1.28 BOX).
            Verify with the board schematic.

    config BATTERY_VOLTAGE_MULTIPLIER
        int "Battery voltage divider multiplier (Vbat = Vadc * N)"
        default 2
        range 1 8
        help
            If the board has a 100k+100k resistor divider, Vbat = Vadc * 2
            so set this to 2. Adjust if your divider ratio differs.

endmenu
```

## sdkconfig.defaults
```kconfig
CONFIG_IDF_TARGET="esp32s3"
CONFIG_ESPTOOLPY_FLASHSIZE_16MB=y
CONFIG_ESPTOOLPY_FLASHMODE_QIO=y
CONFIG_ESP_DEFAULT_CPU_FREQ_MHZ_240=y
CONFIG_PARTITION_TABLE_CUSTOM=y
CONFIG_PARTITION_TABLE_CUSTOM_FILENAME="partitions.csv"
CONFIG_PARTITION_TABLE_FILENAME="partitions.csv"

CONFIG_SPIRAM=y
CONFIG_SPIRAM_MODE_OCT=y
CONFIG_SPIRAM_SPEED_80M=y
CONFIG_SPIRAM_MALLOC_ALWAYSINTERNAL=4096
CONFIG_SPIRAM_MALLOC_RESERVE_INTERNAL=49152
CONFIG_SPIRAM_MEMTEST=n

CONFIG_FATFS_LFN_HEAP=y
CONFIG_AUDIO_PLAYER_ENABLE_MP3=y
CONFIG_AUDIO_PLAYER_ENABLE_WAV=n
CONFIG_AUDIO_PLAYER_ENABLE_AAC=y
CONFIG_LV_COLOR_DEPTH_16=y
CONFIG_LV_MEM_CUSTOM=y
CONFIG_LV_MEMCPY_MEMSET_STD=y
CONFIG_LV_FONT_MONTSERRAT_12=y
CONFIG_LV_FONT_MONTSERRAT_16=y

CONFIG_MBEDTLS_DEFAULT_MEM_ALLOC=y
CONFIG_MBEDTLS_DYNAMIC_BUFFER=y
CONFIG_MBEDTLS_DYNAMIC_FREE_PEER_CERT=y
CONFIG_MBEDTLS_DYNAMIC_FREE_CONFIG_DATA=y

CONFIG_SPIRAM=y
CONFIG_SPIRAM_MODE_OCT=y
CONFIG_SPIRAM_SPEED_80M=y
CONFIG_ESPTOOLPY_FLASHSIZE_16MB=y
CONFIG_LV_COLOR_16_SWAP=y
CONFIG_LV_FONT_MONTSERRAT_12=y
CONFIG_LV_FONT_MONTSERRAT_14=y
CONFIG_LV_FONT_MONTSERRAT_16=y
CONFIG_LV_FONT_MONTSERRAT_20=y
CONFIG_LV_FONT_MONTSERRAT_22=y
CONFIG_LV_FONT_MONTSERRAT_48=y

CONFIG_ESP_MAIN_TASK_STACK_SIZE=8192
CONFIG_FREERTOS_WATCHPOINT_END_OF_STACK=y
```
